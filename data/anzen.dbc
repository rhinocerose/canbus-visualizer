VERSION "0.10"

NS_ :

BS_:
BU_: MASTER SLAVE

BO_ 406768872 TEMP_VOLTAGE_FRAME: 8 MASTER
    SG_ temperature_diode : 0|8@1+ (1,-40) [-40|215] "Celcius" SLAVE
    SG_ voltage_max_mono : 40|16@0+ (0.001,0) [0|0] "Volts" SLAVE
    SG_ voltage_min_mono : 24|16@0+ (0.001,0) [0|0] "Volts" SLAVE
    SG_ temperature_contactor : 40|8@1+ (1,-40) [-40|215] "Celcius" SLAVE
    SG_ temperature_max_mono : 48|8@1+ (1,-40) [-40|215] "Celcius" SLAVE
    SG_ temperature_min_mono : 56|8@1+ (1,-40) [-40|215] "Celcius" SLAVE

BO_ 406899944 POWER_CURRENT: 8 MASTER
    SG_ power_instant : 0|16@0+ (1,0) [0|0] "Watt-Hours" SLAVE
    SG_ power_cumulative : 48|16@0+ (1,0) [0|0] "Watt-Hours" SLAVE
    SG_ current_hall : 16|16@0+ (0.1,-1600) [0|0] "Amps" SLAVE
    SG_ current_shunt : 0|16@0+ (0.1,-1600) [0|0] "Amps" SLAVE

BO_ 406834408 SOC_CURRENT: 8 MASTER
    SG_ state_current_num : 0|8@1+ (1,0) [0|0] "" SLAVE
    SG_ soc : 8|8@1+ (1,0) [0|100] "Percent" SLAVE
    SG_ inputs : 16|8@1+ (1,0) [0|0] "" SLAVE
    SG_ outputs : 24|8@1+ (1,0) [0|0] "" SLAVE
    SG_ voltage_stack : 16|16@0+ (0.1,0) [0|0] "Volts" SLAVE
    SG_ current_system : 0|16@0+ (0.1,-1600) [0|0] "Amps" SLAVE

BO_ 406975874 RANDOM1: 8 MASTER
BO_ 406058371 RANDOM2: 8 MASTER
BO_ 406582504 RANDOM3: 8 MASTER
BO_ 406713576 RANDOM4: 8 MASTER
BO_ 406975875 RANDOM5: 8 MASTER
BO_ 405858548 RANDOM6: 8 MASTER
BO_ 406385896 RANDOM7: 8 MASTER
BO_ 403734773 RANDOM8: 8 MASTER
BO_ 405962997 RANDOM9: 8 MASTER
BO_ 406880501 RANDOM10: 8 MASTER
BO_ 403735029 RANDOM11: 8 MASTER
BO_ 405963253 RANDOM12: 8 MASTER
BO_ 406880757 RANDOM13: 8 MASTER

CM_ BO_ 406768872 "Temp Voltage Frame 183ECCE8";
CM_ SG_ 406768872 temperature_diode "Diode temperature";
CM_ SG_ 406768872 temperature_contactor "Contactor temperature";
CM_ SG_ 406768872 temperature_max_mono "Maximum monoblock temperature";
CM_ SG_ 406768872 temperature_min_mono "Minimum monoblock temperature";
CM_ SG_ 406768872 voltage_max_mono "Maximum monoblock voltage";
CM_ SG_ 406768872 voltage_min_mono "Minimum monoblock voltage";
CM_ BO_ 406899944 "Power Current Frame 1840CCE8";
CM_ SG_ 406899944 power_instant "Instant power";
CM_ SG_ 406899944 power_cumulative "Cumulative power";
CM_ SG_ 406899944 current_hall "Hall effect current";
CM_ SG_ 406899944 current_shunt "Shunt current";
CM_ BO_ 406834408 "SOC Current Frame 183FCCE8";
CM_ SG_ 406834408 state_current_num "State - current number";
CM_ SG_ 406834408 soc "SOC";
CM_ SG_ 406834408 inputs "Inputs";
CM_ SG_ 406834408 outputs "Outputs";
CM_ SG_ 406834408 voltage_stack "Stack voltage - HV1";
CM_ SG_ 406834408 current_system "System Current";

BA_DEF_ SG_  "SPN" INT 0 524287;

BA_DEF_ BO_  "VFrameFormat" ENUM  "StandardCAN","ExtendedCAN","reserved","J1939PG";
BA_DEF_ BO_  "FilterLabel" INT 0 1;

BA_DEF_DEF_  "SPN" 0;
BA_DEF_DEF_  "VFrameFormat" "J1939PG";
BA_DEF_DEF_  "FilterLabel" 1;

BA_ "SPN" SG_ 406768872 temperature_diode 190;
BA_ "SPN" SG_ 406768872 temperature_contactor 192;
BA_ "SPN" SG_ 406768872 temperature_max_mono 194;
BA_ "SPN" SG_ 406768872 temperature_min_mono 196;
BA_ "SPN" SG_ 406768872 voltage_max_mono 198;
BA_ "SPN" SG_ 406768872 voltage_min_mono 199;

BA_ "SPN" SG_ 406899944 power_instant 202;
BA_ "SPN" SG_ 406899944 power_cumulative 204;
BA_ "SPN" SG_ 406899944 current_hall 206;
BA_ "SPN" SG_ 406899944 current_shunt 208;

BA_ "SPN" SG_ 406834408 state_current_num 210;
BA_ "SPN" SG_ 406834408 soc 212;
BA_ "SPN" SG_ 406834408 inputs 214;
BA_ "SPN" SG_ 406834408 outputs 216;
BA_ "SPN" SG_ 406834408 voltage_stack 218;
BA_ "SPN" SG_ 406834408 current_system 220;
