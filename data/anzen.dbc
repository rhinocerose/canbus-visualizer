VERSION "0.10"

NS_ :

BS_:
BU_: MASTER SLAVE

BO_ 406768872 TEMP_VOLTAGE_FRAME: 8 MASTER
    SG_ temperature_diode : 0|8@1+ (1,-40) [-40|215] "Celcius" SLAVE
    SG_ voltage_max_mono : 40|16@0+ (0.001,0) [0|65.535] "Volts" SLAVE
    SG_ voltage_min_mono : 24|16@0+ (0.001,0) [0|65.535] "Volts" SLAVE
    SG_ temperature_contactor : 40|8@1+ (1,-40) [-40|215] "Celcius" SLAVE
    SG_ temperature_max_mono : 48|8@1+ (1,-40) [-40|215] "Celcius" SLAVE
    SG_ temperature_min_mono : 56|8@1+ (1,-40) [-40|215] "Celcius" SLAVE

BO_ 406899944 POWER_CURRENT: 8 MASTER
    SG_ power_instant : 0|16@0+ (0.1,-1600) [-1600|4953.5] "Watt-Hours" SLAVE
    SG_ power_cumulative : 48|16@0+ (0.1,-1600) [-1600|4953.5] "Watt-Hours" SLAVE
    SG_ current_hall : 16|16@0+ (0.1,-1600) [-1600|4953.5] "Amps" SLAVE
    SG_ current_shunt : 0|16@0+ (0.1,-1600) [-1600|4953.5] "Amps" SLAVE

BO_ 406834408 SOC_CURRENT: 8 MASTER
    SG_ state_current_num : 0|8@1+ (1,0) [0|7] "STATE" SLAVE
    SG_ soc : 8|8@1+ (1,0) [0|100] "Percent" SLAVE
    SG_ input_1 : 16|1@1+ (1,0) [0|0] "" SLAVE
    SG_ input_2 : 17|1@1+ (1,0) [0|0] "" SLAVE
    SG_ input_3 : 18|1@1+ (1,0) [0|0] "" SLAVE
    SG_ input_4 : 19|1@1+ (1,0) [0|0] "" SLAVE
    SG_ input_5 : 20|1@1+ (1,0) [0|0] "" SLAVE
    SG_ input_6 : 21|1@1+ (1,0) [0|0] "" SLAVE
    SG_ input_7 : 22|1@1+ (1,0) [0|0] "" SLAVE
    SG_ input_8 : 23|1@1+ (1,0) [0|0] "" SLAVE
    SG_ output_1 : 24|1@1+ (1,0) [0|0] "" SLAVE
    SG_ output_2 : 25|1@1+ (1,0) [0|0] "" SLAVE
    SG_ output_3 : 26|1@1+ (1,0) [0|0] "" SLAVE
    SG_ output_4 : 27|1@1+ (1,0) [0|0] "" SLAVE
    SG_ output_5 : 28|1@1+ (1,0) [0|0] "" SLAVE
    SG_ output_6 : 29|1@1+ (1,0) [0|0] "" SLAVE
    SG_ output_7 : 30|1@1+ (1,0) [0|0] "" SLAVE
    SG_ output_8 : 31|1@1+ (1,0) [0|0] "" SLAVE
    SG_ voltage_stack : 16|16@0+ (0.1,0) [0|6553.5] "Volts" SLAVE
    SG_ current_system : 0|16@0+ (0.1,-1600) [-1600|4953.5] "Amps" SLAVE

BO_ 406637800 DEBUG_FRAME: 8 MASTER
    SG_ debug_frame_id M : 0|8@1+ (1,0) [0|0] "" SLAVE
    SG_ voltage_hv1 m4 : 8|16@1+ (0.1,0) [0|6553.5] "Volts" SLAVE
    SG_ voltage_hv2 m4 : 24|16@1+ (0.1,0) [0|6553.5] "Volts" SLAVE
    SG_ voltage_supply m4 : 40|16@1+ (0.1,0) [0|6553.5] "Volts" SLAVE

BO_ 406113512 RAW_FRAME: 8 MASTER
    SG_ raw_frameid M : 0|8@1+ (1,0) [0|7] "" SLAVE
    SG_ raw_soc m2 : 56|8@1+ (1,0) [0|100] "Percent" SLAVE
    SG_ raw_state_present_num m1 : 8|8@1+ (1,0) [0|7] "STATE" SLAVE
    SG_ raw_state_previous_num m1 : 16|8@1+ (1,0) [0|7] "STATE" SLAVE
    SG_ raw_state_historic_num m1 : 24|8@1+ (1,0) [0|7] "STATE" SLAVE
    SG_ raw_temperature_system m1 : 40|8@1+ (1,-40) [-40|215] "Celcius" SLAVE
    SG_ raw_state_error_message m1 : 32|8@1+ (1,0) [0|25] "" SLAVE
    SG_ raw_temperature_diode m1 : 48|8@1+ (1,-40) [-40|215] "Celcius" SLAVE
    SG_ raw_temperature_contactor m1 : 56|8@1+ (1,-40) [-40|215] "Celcius" SLAVE
    SG_ raw_current_system m2 : 8|16@0+ (0.1,-1600) [-1600|4953.5] "Amps" SLAVE
    SG_ raw_current_hall m2 : 24|16@0+ (0.1,-1600) [-1600|4953.5] "Amps" SLAVE
    SG_ raw_current_shunt m2 : 40|16@0+ (0.1,-1600) [-1600|4953.5] "Amps" SLAVE
    SG_ raw_k_value m3 : 8|16@0+ (1,0) [0|65535] "" SLAVE
    SG_ raw_voltage_inverter m3 : 24|16@0+ (0.1,0) [0|6553.5] "Volts" SLAVE
    SG_ raw_voltage_supply m3 : 40|16@0+ (0.1,0) [0|6553.5] "Volts" SLAVE
    SG_ raw_soh m3 : 56|8@1+ (1,0) [0|100] "Percent" SLAVE
    SG_ raw_discharge_cumulative m4 : 8|16@0+ (0.1,-1600) [-1600|4953.5] "Amp-Hours" SLAVE
    SG_ raw_discharge_absolute m4 : 24|16@0+ (0.1,-1600) [-1600|4953.5] "Amp-Hours" SLAVE
    SG_ raw_months_of_service m4 : 40|16@0+ (0.1,-1600) [-1600|4953.5] "Months" SLAVE

BO_ 405851368 MONOBLOCK_VOLTAGE_FRAMES: 8 MASTER
    SG_ raw_mb_voltage_frameid M : 0|8@1+ (1,0) [0|12] "" SLAVE
    SG_ raw_mb1_voltage m1 : 32|16@0+ (0.001,0) [0|6553.5] "Volts" SLAVE
    SG_ raw_mb2_voltage m1 : 16|16@0+ (0.001,0) [0|6553.5] "Volts" SLAVE
    SG_ raw_mb3_voltage m1 : 0|16@0+ (0.001,0) [0|6553.5] "Volts" SLAVE
    SG_ raw_mb4_voltage m2 : 32|16@0+ (0.001,0) [0|6553.5] "Volts" SLAVE
    SG_ raw_mb5_voltage m2 : 16|16@0+ (0.001,0) [0|6553.5] "Volts" SLAVE
    SG_ raw_mb6_voltage m2 : 0|16@0+ (0.001,0) [0|6553.5] "Volts" SLAVE
    SG_ raw_mb7_voltage m3 : 32|16@0+ (0.001,0) [0|6553.5] "Volts" SLAVE
    SG_ raw_mb8_voltage m3 : 16|16@0+ (0.001,0) [0|6553.5] "Volts" SLAVE
    SG_ raw_mb9_voltage m3 : 0|16@0+ (0.001,0) [0|6553.5] "Volts" SLAVE
    SG_ raw_mb10_voltage m4 : 32|16@0+ (0.001,0) [0|6553.5] "Volts" SLAVE
    SG_ raw_mb11_voltage m4 : 16|16@0+ (0.001,0) [0|6553.5] "Volts" SLAVE
    SG_ raw_mb12_voltage m4 : 0|16@0+ (0.001,0) [0|6553.5] "Volts" SLAVE
    SG_ raw_mb13_voltage m5 : 32|16@0+ (0.001,0) [0|6553.5] "Volts" SLAVE
    SG_ raw_mb14_voltage m5 : 16|16@0+ (0.001,0) [0|6553.5] "Volts" SLAVE
    SG_ raw_mb15_voltage m5 : 0|16@0+ (0.001,0) [0|6553.5] "Volts" SLAVE
    SG_ raw_mb16_voltage m6 : 32|16@0+ (0.001,0) [0|6553.5] "Volts" SLAVE
    SG_ raw_mb17_voltage m6 : 16|16@0+ (0.001,0) [0|6553.5] "Volts" SLAVE
    SG_ raw_mb18_voltage m6 : 0|16@0+ (0.001,0) [0|6553.5] "Volts" SLAVE
    SG_ raw_mb19_voltage m7 : 32|16@0+ (0.001,0) [0|6553.5] "Volts" SLAVE
    SG_ raw_mb20_voltage m7 : 16|16@0+ (0.001,0) [0|6553.5] "Volts" SLAVE
    SG_ raw_mb21_voltage m7 : 0|16@0+ (0.001,0) [0|6553.5] "Volts" SLAVE
    SG_ raw_mb22_voltage m8 : 32|16@0+ (0.001,0) [0|6553.5] "Volts" SLAVE
    SG_ raw_mb23_voltage m8 : 16|16@0+ (0.001,0) [0|6553.5] "Volts" SLAVE
    SG_ raw_mb24_voltage m8 : 0|16@0+ (0.001,0) [0|6553.5] "Volts" SLAVE
    SG_ raw_mb25_voltage m9 : 32|16@0+ (0.001,0) [0|6553.5] "Volts" SLAVE
    SG_ raw_mb26_voltage m9 : 16|16@0+ (0.001,0) [0|6553.5] "Volts" SLAVE
    SG_ raw_mb27_voltage m9 : 0|16@0+ (0.001,0) [0|6553.5] "Volts" SLAVE
    SG_ raw_mb28_voltage m10 : 32|16@0+ (0.001,0) [0|6553.5] "Volts" SLAVE
    SG_ raw_mb29_voltage m10 : 16|16@0+ (0.001,0) [0|6553.5] "Volts" SLAVE
    SG_ raw_mb30_voltage m10 : 0|16@0+ (0.001,0) [0|6553.5] "Volts" SLAVE
    SG_ raw_mb31_voltage m11 : 32|16@0+ (0.001,0) [0|6553.5] "Volts" SLAVE
    SG_ raw_mb32_voltage m11 : 16|16@0+ (0.001,0) [0|6553.5] "Volts" SLAVE
    SG_ raw_mb33_voltage m11 : 0|16@0+ (0.001,0) [0|6553.5] "Volts" SLAVE
    SG_ raw_mb34_voltage m12 : 32|16@0+ (0.001,0) [0|6553.5] "Volts" SLAVE
    SG_ raw_mb35_voltage m12 : 16|16@0+ (0.001,0) [0|6553.5] "Volts" SLAVE
    SG_ raw_mb36_voltage m12 : 0|16@0+ (0.001,0) [0|6553.5] "Volts" SLAVE
    SG_ raw_mb37_voltage m13 : 32|16@0+ (0.001,0) [0|6553.5] "Volts" SLAVE
    SG_ raw_mb38_voltage m13 : 16|16@0+ (0.001,0) [0|6553.5] "Volts" SLAVE

BO_ 405916904 MONOBLOCK_TEMPERATURE_FRAMES: 8 MASTER
BO_ 406375656 STATE_MACHINE_DEBUG_FRAMES: 8 MASTER

BO_ 406703336 ERROR_FRAME: 8 MASTER
    SG_ raw_errorid M : 0|8@1+ (1,0) [0|0] "" SLAVE
    SG_ critical_feed_charge_overcurrent m1 : 16|1@1+ (1,0) [0|0] "" SLAVE
    SG_ critical_slow_charge_overcurrent m1 : 17|1@1+ (1,0) [0|0] "" SLAVE
    SG_ critical_pack_overvolt m1 : 18|1@1+ (1,0) [0|0] "" SLAVE
    SG_ critical_pack_undervolt m1 : 19|1@1+ (1,0) [0|0] "" SLAVE
    SG_ critical_pack_overtemp m1 : 20|1@1+ (1,0) [0|0] "" SLAVE
    SG_ critical_pack_undertemp m1 : 21|1@1+ (1,0) [0|0] "" SLAVE
    SG_ critical_power_supply_overvolt m1 : 22|1@1+ (1,0) [0|0] "" SLAVE
    SG_ critical_power_supply_undervolt m1 : 23|1@1+ (1,0) [0|0] "" SLAVE
    SG_ critical_cell_charge_overtemp m1 : 24|1@1+ (1,0) [0|0] "" SLAVE
    SG_ critical_cell_voltage_differential m1 : 25|1@1+ (1,0) [0|0] "" SLAVE
    SG_ critical_single_cell_undervolt m1 : 26|1@1+ (1,0) [0|0] "" SLAVE
    SG_ critical_single_cell_overvolt m1 : 27|1@1+ (1,0) [0|0] "" SLAVE
    SG_ critical_soc_low m1 : 28|1@1+ (1,0) [0|0] "" SLAVE
    SG_ critical_soc_high m1 : 29|1@1+ (1,0) [0|0] "" SLAVE
    SG_ critical_insulation_resistance m1 : 30|1@1+ (1,0) [0|0] "" SLAVE
    SG_ critical_discharge_overcurrent m1 : 31|1@1+ (1,0) [0|0] "" SLAVE
    SG_ critical_cell_soc_differential m1 : 35|1@1+ (1,0) [0|0] "" SLAVE
    SG_ critical_cell_temperature_differential m1 : 36|1@1+ (1,0) [0|0] "" SLAVE
    SG_ critical_discharge_overtemp m1 : 37|1@1+ (1,0) [0|0] "" SLAVE
    SG_ critical_charge_overtemp m1 : 38|1@1+ (1,0) [0|0] "" SLAVE
    SG_ critical_charge_undertemp m1 : 39|1@1+ (1,0) [0|0] "" SLAVE

CM_ BO_ 406768872 "Temp Voltage Frame 183ECCE8";
CM_ BO_ 406899944 "Power Current Frame 1840CCE8";
CM_ BO_ 406834408 "SOC Current Frame 183FCCE8";

BA_DEF_ BO_  "VFrameFormat" ENUM  "StandardCAN","ExtendedCAN","reserved","J1939PG";
BA_DEF_ BO_  "FilterLabel" INT 0 1;

BA_DEF_DEF_  "VFrameFormat" "J1939PG";
BA_DEF_DEF_  "FilterLabel" 1;
