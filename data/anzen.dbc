VERSION ""

NS_ :

BS_:
BU_: MASTER SLAVE

BO_ 406768872 TEMP_VOLTAGE_FRAME: 8 MASTER
    SG_ temperature_diode : 0|8@1+ (1,-40) [-40|215] "Celcius" SLAVE
    SG_ voltage_max_mono : 40|16@0+ (0.001,0) [0|0] "Volts" SLAVE
    SG_ voltage_min_mono : 24|16@0+ (0.001,0) [0|0] "Volts" SLAVE
    SG_ temperature_contactor : 40|8@1+ (1,-40) [-40|215] "Celcius" SLAVE
    SG_ temperature_max_mono : 48|8@1+ (1,-40) [-40|215] "Celcius" SLAVE
    SG_ temperature_min_mono : 56|8@1+ (1,-40) [-40|215] "Celcius" SLAVE

BO_ 406899944 POWER_CURRENT: 8 MASTER
    SG_ power_instant : 0|16@0+ (1,0) [0|0] "Watt-Hours" SLAVE
    SG_ power_cumulative : 48|16@0+ (1,0) [0|0] "Watt-Hours" SLAVE
    SG_ current_hall : 16|16@0+ (0.1,-1600) [0|0] "Amps" SLAVE
    SG_ current_shunt : 0|16@0+ (0.1,-1600) [0|0] "Amps" SLAVE

BO_ 406834408 SOC_CURRENT: 8 MASTER
    SG_ state_current_num : 0|8@1+ (1,0) [0|0] "" SLAVE
    SG_ soc : 8|8@1+ (1,0) [0|100] "Percent" SLAVE
    SG_ inputs : 16|8@1+ (1,0) [0|0] "" SLAVE
    SG_ outputs : 24|8@1+ (1,0) [0|0] "" SLAVE
    SG_ voltage_stack : 16|16@0+ (0.1,0) [0|0] "Volts" SLAVE
    SG_ current_system : 0|16@0+ (0.1,-1600) [0|0] "Amps" SLAVE

BO_ 406637800 DEBUG_FRAME: 8 MASTER
   SG_ debug_frame_id M : 0|8@1+ (1,0) [0|0] "" SLAVE
   SG_ voltage_hv1 m4 : 8|16@1+ (1,0) [0|0] "Volts" SLAVE
   SG_ voltage_hv2 m4 : 24|16@1+ (1,0) [0|0] "Volts" SLAVE
   SG_ voltage_supply m4 : 40|16@1+ (1,0) [0|0] "Volts" SLAVE

BO_ 406113512 RAW_FRAME: 8 MASTER
   SG_ raw_frameid M : 0|8@1+ (1,0) [0|0] "" SLAVE
   SG_ raw_soc m2 : 56|8@1+ (1,0) [0|100] "Percent" SLAVE
   SG_ raw_state_present_num m1 : 8|8@1+ (1,0) [0|0] "0" MASTER
   SG_ raw_state_previous_num m1 : 16|8@1+ (1,0) [0|0] "" MASTER
   SG_ raw_state_historic_num m1 : 24|8@1+ (1,0) [0|0] "" MASTER
   SG_ raw_temperature_system m1 : 40|8@1+ (1,-40) [0|0] "Celcius" MASTER
   SG_ raw_state_error_message m1 : 32|8@1+ (1,0) [0|0] "" MASTER
   SG_ raw_temperature_diode m1 : 48|8@1+ (1,-40) [0|0] "Celcius" MASTER
   SG_ raw_temperature_contactor m1 : 56|8@1+ (1,-40) [0|0] "Celcius" MASTER
   SG_ raw_current_system m2 : 8|16@1+ (0.1,-1600) [0|0] "Amps" SLAVE
   SG_ raw_current_hall m2 : 24|16@1+ (0.1,-1600) [0|0] "Amps" SLAVE
   SG_ raw_current_shunt m2 : 40|16@1+ (0.1,-1600) [0|0] "Amps" SLAVE

CM_ BO_ 406768872 "Temp Voltage Frame 183ECCE8";
CM_ SG_ 406768872 temperature_diode "Diode temperature";
CM_ SG_ 406768872 temperature_contactor "Contactor temperature";
CM_ SG_ 406768872 temperature_max_mono "Maximum monoblock temperature";
CM_ SG_ 406768872 temperature_min_mono "Minimum monoblock temperature";
CM_ SG_ 406768872 voltage_max_mono "Maximum monoblock voltage";
CM_ SG_ 406768872 voltage_min_mono "Minimum monoblock voltage";
CM_ BO_ 406899944 "Power Current Frame 1840CCE8"
CM_ SG_ 406899944 power_instant "Instant power";
CM_ SG_ 406899944 power_cumulative "Cumulative power";
CM_ SG_ 406899944 current_hall "Hall effect current";
CM_ SG_ 406899944 current_shunt "Shunt current";
CM_ BO_ 406834408 "SOC Current Frame 183FCCE8";
CM_ SG_ 406834408 state_current_num "State - current number";
CM_ SG_ 406834408 soc "SOC";
CM_ SG_ 406834408 inputs "Inputs"
CM_ SG_ 406834408 outputs "Outputs"
CM_ SG_ 406834408 voltage_stack "Stack voltage - HV1"
CM_ SG_ 406834408 current_system "System Current"

BA_DEF_ BO_ "GenMsgBackgroundColor" STRING ;
BA_DEF_ BO_ "GenMsgForegroundColor" STRING ;
BA_DEF_DEF_ "GenMsgBackgroundColor" "#ffffff";
BA_DEF_DEF_ "GenMsgForegroundColor" "#000000";
